/*
 * Flux Keyboard right half.
 * SPDX-License-Identifier: MIT
 */

#include "flux_keyboard.dtsi"

&default_transform {
    col-offset = <8>;
};

&kscan {
    /* Column GPIO order: D15, D14, D10, D9, D8, D7, D6, D5. */
    col-gpios
        = <&pro_micro 15 GPIO_ACTIVE_HIGH>
        , <&pro_micro 14 GPIO_ACTIVE_HIGH>
        , <&pro_micro 10 GPIO_ACTIVE_HIGH>
        , <&pro_micro 9 GPIO_ACTIVE_HIGH>
        , <&pro_micro 8 GPIO_ACTIVE_HIGH>
        , <&pro_micro 7 GPIO_ACTIVE_HIGH>
        , <&pro_micro 6 GPIO_ACTIVE_HIGH>
        , <&pro_micro 5 GPIO_ACTIVE_HIGH>
        ;
};
