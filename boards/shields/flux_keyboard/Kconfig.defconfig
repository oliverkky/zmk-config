## boards/shields/flux_keyboard/Kconfig.defconfig
```kconfig
if SHIELD_FLUX_KEYBOARD_LEFT

config ZMK_KEYBOARD_NAME
    default "Flux Keyboard"

config ZMK_SPLIT_ROLE_CENTRAL
    default y

endif # SHIELD_FLUX_KEYBOARD_LEFT

if SHIELD_FLUX_KEYBOARD_LEFT || SHIELD_FLUX_KEYBOARD_RIGHT

config ZMK_SPLIT
    default y

endif # SHIELD_FLUX_KEYBOARD_LEFT || SHIELD_FLUX_KEYBOARD_RIGHT
```

## boards/shields/flux_keyboard/Kconfig.shield
```kconfig
config SHIELD_FLUX_KEYBOARD_LEFT
    def_bool $(shields_list_contains,flux_keyboard_left)

config SHIELD_FLUX_KEYBOARD_RIGHT
    def_bool $(shields_list_contains,flux_keyboard_right)
```
